## apps/graphics3/Kconfig
```kconfig
#
# Copyright (c) 2015, Josef Mihalits
#
# This software may be distributed and modified according to the terms of
# the BSD 2-Clause license. Note that NO WARRANTY is provided.
#

menuconfig APP_GRAPHICS3
    bool "graphics3 -  Vesa BIOS Extension (VBE)"
    default y
    depends on LIB_SEL4 && (LIB_MUSL_C || LIB_SEL4_C) && LIB_SEL4_PLAT_SUPPORT && LIB_SEL4_VKA && LIB_SEL4_UTILS && LIB_UTILS
    help
        Explore Vesa BIOS Extension (VBE)
```

## apps/keyboard2/Kconfig
```kconfig
#
# Copyright 2014, NICTA
#
# This software may be distributed and modified according to the terms of
# the BSD 2-Clause license. Note that NO WARRANTY is provided.
# See "LICENSE_BSD2.txt" for details.
#
# @TAG(NICTA_BSD)
#

menuconfig APP_KEYBOARD2
    bool "keyboard2 - read from keyboard (async endpoint)"
    default y
    depends on LIB_SEL4 && (LIB_MUSL_C || LIB_SEL4_C) && LIB_SEL4_PLAT_SUPPORT && LIB_SEL4_VKA && LIB_SEL4_TEST && LIB_SEL4_UTILS && LIB_UTILS
    help
        Read from keyboard - test application
```

## apps/keyboard3/Kconfig
```kconfig
#
# Copyright (c) 2015, Josef Mihalits
#
# This software may be distributed and modified according to the terms of
# the BSD 2-Clause license. Note that NO WARRANTY is provided.
#

menuconfig APP_KEYBOARD3
    bool "keyboard3 - keyboard events and scan codes"
    default y
    depends on LIB_SEL4 && (LIB_MUSL_C || LIB_SEL4_C) && LIB_SEL4_PLAT_SUPPORT && LIB_SEL4_VKA && LIB_SEL4_UTILS && LIB_UTILS
    help
        Test program for low level keyboard access.

    choice
        prompt "Method"
        depends on APP_KEYBOARD3
        default APP_KEYBOARD3_WAIT
        help
            Select type of test program.

        config APP_KEYBOARD3_POLL
            bool "Poll keyboard"
            help
                Use busy loop and poll keyboard.

        config APP_KEYBOARD3_WAIT
            bool "Wait for interrupt"
            help
                Call seL4_Wait to explicitly wait for IRQ.
    endchoice

	menuconfig APP_KEYBOARD3_SHOWPRESSED
	    bool "      Show list of currently pressed keys"
	    depends on APP_KEYBOARD3 && APP_KEYBOARD3_POLL
	    default n
	    help
```

## apps/loaddata/Kconfig
```kconfig
#
# Copyright 2014, NICTA
#
# This software may be distributed and modified according to the terms of
# the BSD 2-Clause license. Note that NO WARRANTY is provided.
# See "LICENSE_BSD2.txt" for details.
#
# @TAG(NICTA_BSD)
#

menuconfig APP_LOADDATA
    bool "loaddata - how to get data into memory"
    default y
    depends on LIB_SEL4 && (LIB_MUSL_C || LIB_SEL4_C) && LIB_SEL4_PLAT_SUPPORT && LIB_SEL4_VKA && LIB_SEL4_TEST && LIB_SEL4_UTILS && LIB_UTILS
    help
        seL4 Test application - how to get data into RAM

config HAVE_TIMER
    depends on APP_SEL4TEST
    bool "Enable tests that require a timer driver"
    default n

config HAVE_CACHE
    depends on APP_SEL4TEST
    bool "Enable tests that require a functioning cache"
    default n
```

## apps/timer/Kconfig
```kconfig
#
# Copyright (c) 2015, Josef Mihalits
#
# This software may be distributed and modified according to the terms of
# the BSD 2-Clause license. Note that NO WARRANTY is provided.
#

menuconfig APP_TIMER
    bool "timer - exercise timer functions"
    default y
    depends on LIB_SEL4 && (LIB_MUSL_C || LIB_SEL4_C) && LIB_SEL4_PLAT_SUPPORT && LIB_SEL4_VKA && LIB_SEL4_UTILS && LIB_UTILS
    help
        Test program for platsupport timer functions
```
